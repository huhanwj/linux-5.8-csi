## backports-4.19.7-1/drivers/net/wireless/mediatek/mt76/Kconfig
```kconfig
config MT76_CORE
	tristate
	depends on m

config MT76_USB
	tristate
	depends on m
	depends on MT76_CORE

config MT76x2_COMMON
	tristate
	depends on m
	depends on MT76_CORE

config MT76x0U
	depends on !KERNEL_4_1
	tristate "MediaTek MT76x0U (USB) support"
	depends on m
	select MT76_CORE
	depends on MAC80211
	depends on USB
	help
	  This adds support for MT7610U-based wireless USB dongles.

config MT76x2E
	depends on !KERNEL_4_1
	tristate "MediaTek MT76x2E (PCIe) support"
	depends on m
	select MT76_CORE
	select MT76x2_COMMON
	depends on MAC80211
	depends on PCI
	---help---
	  This adds support for MT7612/MT7602/MT7662-based wireless PCIe devices.

config MT76x2U
	depends on !KERNEL_4_1
	tristate "MediaTek MT76x2U (USB) support"
	depends on m
	select MT76_CORE
	select MT76_USB
	select MT76x2_COMMON
	depends on MAC80211
	depends on USB
	help
	  This adds support for MT7612U-based wireless USB dongles.
```

## backports-4.19.7-1/drivers/net/wireless/quantenna/qtnfmac/Kconfig
```kconfig
config QTNFMAC
	tristate
	depends on m
	depends on QTNFMAC_PEARL_PCIE
	default m if QTNFMAC_PEARL_PCIE=m
	default y if QTNFMAC_PEARL_PCIE=y

config QTNFMAC_PEARL_PCIE
	depends on !KERNEL_3_13
	tristate "Quantenna QSR10g PCIe support"
	depends on m
	default n
	depends on PCI && CFG80211
	select QTNFMAC
	depends on FW_LOADER
	depends on CRC32
	---help---
	  This option adds support for wireless adapters based on Quantenna
	  802.11ac QSR10g (aka Pearl) FullMAC chipset running over PCIe.

	  If you choose to build it as a module, two modules will be built:
	  qtnfmac.ko and qtnfmac_pearl_pcie.ko.
```
